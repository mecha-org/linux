## Documentation/devicetree/bindings/clock/nxp,imx95-lvds-blk-ctl.yaml
```yaml
# SPDX-License-Identifier: (GPL-2.0-only OR BSD-2-Clause)
%YAML 1.2
---
$id: http://devicetree.org/schemas/clock/nxp,imx95-lvds-blk-ctl.yaml#
$schema: http://devicetree.org/meta-schemas/core.yaml#

title: NXP i.MX95 LVDS Block Control

maintainers:
  - Marek Vasut <marek.vasut@mailbox.org>
  - Peng Fan <peng.fan@nxp.com>

properties:
  compatible:
    items:
      - const: nxp,imx95-lvds-csr
      - const: syscon

  reg:
    maxItems: 1

  power-domains:
    maxItems: 1

  clocks:
    maxItems: 1

  '#clock-cells':
    const: 1
    description:
      The clock consumer should specify the desired clock by having the clock
      ID in its "clocks" phandle cell. See
      include/dt-bindings/clock/nxp,imx95-clock.h

  "#address-cells":
    const: 1

  "#size-cells":
    const: 1

patternProperties:
  "^lvds@[0-9a-f]+$":
    type: object
    additionalProperties: true

    properties:
      compatible:
        const: fsl,imx95-lvds

  "^phy@[0-9a-f]+$":
    type: object
    additionalProperties: true

    properties:
      compatible:
        const: fsl,imx95-ldb

required:
  - compatible
  - reg
  - '#clock-cells'
  - power-domains
  - clocks
  - "#address-cells"
  - "#size-cells"

unevaluatedProperties: false

examples:
  - |
    syscon@4c410000 {
      compatible = "nxp,imx95-lvds-csr", "syscon";
      #address-cells = <1>;
      #size-cells = <1>;
      reg = <0x4b0c0000 0x10000>;
      #clock-cells = <1>;
      clocks = <&scmi_clk 76>;
      power-domains = <&scmi_devpd 13>;
    };
...
```

## Documentation/devicetree/bindings/display/bridge/fsl,imx95-lvds.yaml
```yaml
# SPDX-License-Identifier: (GPL-2.0-only OR BSD-2-Clause)
%YAML 1.2
---
$id: http://devicetree.org/schemas/display/bridge/fsl,imx95-lvds.yaml#
$schema: http://devicetree.org/meta-schemas/core.yaml#

title: Freescale i.MX95 LVDS Display Bridge

maintainers:
  - Marek Vasut <marek.vasut@mailbox.org>

description: |
  The Freescale i.MX95 LVDS Display Bridge(LDB) has two channels.

  The i.MX8qm/qxp LDB is controlled by Control and Status Registers(CSR) module.
  The CSR module, as a system controller, contains the LDB's configuration
  registers.

properties:
  compatible:
    const: fsl,imx95-lvds

  "#address-cells":
    const: 1

  "#size-cells":
    const: 0

  reg:
    maxItems: 1

  clocks:
    maxItems: 4

  clock-names:
    items:
      - const: ldb_di0
      - const: ldb_di1
      - const: ldb_ch0
      - const: ldb_ch1

  power-domains:
    maxItems: 1

patternProperties:
  "^channel@[0-1]$":
    type: object
    description: Represents a channel of LDB.

    properties:
      "#address-cells":
        const: 1

      "#size-cells":
        const: 0

      reg:
        description: The channel index.
        enum: [ 0, 1 ]

      phys:
        description: A phandle to the phy module representing the LVDS PHY.
        maxItems: 1

      phy-names:
        const: lvds_phy

      port@0:
        $ref: /schemas/graph.yaml#/properties/port
        description: Input port of the channel.

      port@1:
        $ref: /schemas/graph.yaml#/properties/port
        description: Output port of the channel.

    required:
      - "#address-cells"
      - "#size-cells"
      - reg
      - phys
      - phy-names

    additionalProperties: false

required:
  - compatible
  - "#address-cells"
  - "#size-cells"
  - clocks
  - clock-names
  - power-domains
  - channel@0
  - channel@1

additionalProperties: false

examples:
  - |
    #include <dt-bindings/firmware/imx/rsrc.h>
    ldb {
        #address-cells = <1>;
        #size-cells = <0>;
        compatible = "fsl,imx95-ldb";
        clocks = <&clk IMX_SC_R_LVDS_0 IMX_SC_PM_CLK_MISC2>,
                 <&clk IMX_SC_R_LVDS_0 IMX_SC_PM_CLK_BYPASS>;
        clock-names = "pixel", "bypass";
        power-domains = <&pd IMX_SC_R_LVDS_0>;

        channel@0 {
            #address-cells = <1>;
            #size-cells = <0>;
            reg = <0>;
            phys = <&mipi_lvds_0_phy>;
            phy-names = "lvds_phy";

            port@0 {
                reg = <0>;

                mipi_lvds_0_ldb_ch0_mipi_lvds_0_pxl2dpi: endpoint {
                    remote-endpoint = <&mipi_lvds_0_pxl2dpi_mipi_lvds_0_ldb_ch0>;
                };
            };
        };

        channel@1 {
            #address-cells = <1>;
            #size-cells = <0>;
            reg = <1>;
            phys = <&mipi_lvds_0_phy>;
            phy-names = "lvds_phy";

            port@0 {
                reg = <0>;

                mipi_lvds_0_ldb_ch1_mipi_lvds_0_pxl2dpi: endpoint {
                    remote-endpoint = <&mipi_lvds_0_pxl2dpi_mipi_lvds_0_ldb_ch1>;
                };
            };
        };
    };
```

## Documentation/devicetree/bindings/display/bridge/fsl,imx95-pixel-interleaver.yaml
```yaml
# SPDX-License-Identifier: (GPL-2.0-only OR BSD-2-Clause)
%YAML 1.2
---
$id: http://devicetree.org/schemas/display/bridge/fsl,imx95-pixel-interleaver.yaml#
$schema: http://devicetree.org/meta-schemas/core.yaml#

title: Freescale i.MX95 Display Pixel Interleaver

maintainers:
  - Liu Ying <victor.liu@nxp.com>
  - Marek Vasut <marek.vasut@mailbox.org>

description: |
  The Freescale i.MX95 Display Pixel Interleaver receives and processes
  2 input display streams from the display controller and routes those
  to 3 pixel link output ports. The interleaver is capable of YUV444 to
  YUV422 conversion and pixel interleaving.

properties:
  compatible:
    const: fsl,imx95-pixel-interleaver

  reg:
    maxItems: 1

  clocks:
    maxItems: 1

  fsl,syscon:
    $ref: /schemas/types.yaml#/definitions/phandle
    description: |
      A phandle which points to Control and Status Registers (CSR) module.

  ports:
    $ref: /schemas/graph.yaml#/properties/ports

    properties:
      port@0:
        $ref: /schemas/graph.yaml#/properties/port
        description: The pixel link input port node from upstream video source.

      port@1:
        $ref: /schemas/graph.yaml#/properties/port
        description: The pixel link output port node to downstream bridge.

    required:
      - port@0
      - port@1

required:
  - compatible
  - fsl,syscon
  - ports

additionalProperties: false

examples:
  - |
    bridge@4b0d0000 {
        compatible = "fsl,imx95-pixel-interleaver";
        reg = <0x4b0d0000 0x50>;
        clocks = <&scmi_clk 0>;
        fsl,syscon = <&dispmix_csr>;

        ports {
            #address-cells = <1>;
            #size-cells = <0>;

            port@0 {
                reg = <0>;

                pixel_interleaver_disp0_to_dpu_disp0: endpoint {
                    remote-endpoint = <&dpu_disp0_to_pixel_interleaver_disp0>;
                };
            };

            port@1 {
                reg = <1>;

                pixel_interleaver_disp0_to_display_pixel_link0: endpoint {
                    remote-endpoint = <&display_pixel_link0_to_pixel_interleaver_disp0>;
                };
            };
        };
    };
```

## Documentation/devicetree/bindings/display/bridge/fsl,imx95-pixel-link.yaml
```yaml
# SPDX-License-Identifier: (GPL-2.0-only OR BSD-2-Clause)
%YAML 1.2
---
$id: http://devicetree.org/schemas/display/bridge/fsl,imx95-pixel-link.yaml#
$schema: http://devicetree.org/meta-schemas/core.yaml#

title: Freescale i.MX95 Display Pixel Link

maintainers:
  - Liu Ying <victor.liu@nxp.com>
  - Marek Vasut <marek.vasut@mailbox.org>

description: |
  The Freescale i.MX95 Display Pixel Link (DPL) forms a standard
  asynchronous linkage between pixel sources (display controller
  or camera module) and pixel consumers(imaging or displays).
  It consists of two distinct functions, a pixel transfer function
  and a control interface. Multiple pixel channels can exist per one
  control channel. This binding documentation is only for pixel links
  whose pixel sources are display controllers.

  The i.MX95 Display Pixel Link is accessed via syscon.

properties:
  compatible:
    const: fsl,imx95-dc-pixel-link

  fsl,dc-stream-id:
    $ref: /schemas/types.yaml#/definitions/uint8
    description: |
      u8 value representing the display controller stream index that the pixel
      link connects to.
    enum: [0, 1]

  fsl,syscon:
    $ref: /schemas/types.yaml#/definitions/phandle
    description: |
      A phandle which points to Control and Status Registers (CSR) module.

  ports:
    $ref: /schemas/graph.yaml#/properties/ports

    properties:
      port@0:
        $ref: /schemas/graph.yaml#/properties/port
        description: The pixel link input port node from upstream video source.

      port@1:
        $ref: /schemas/graph.yaml#/properties/port
        description: The pixel link output port node to downstream bridge.

    required:
      - port@0
      - port@1

required:
  - compatible
  - fsl,dc-stream-id
  - fsl,syscon
  - ports

additionalProperties: false

examples:
  - |
    dc0-pixel-link0 {
        compatible = "fsl,imx95-dc-pixel-link";
        fsl,dc-stream-id = /bits/ 8 <0>;
        fsl,syscon = <&dispmix_csr>;

        ports {
            #address-cells = <1>;
            #size-cells = <0>;

            /* from DC 0 pixel interleaver channel0 */
            port@0 {
                reg = <0>;

                dc0_pixel_link0_dc0_pixel_interleaver_ch0: endpoint {
                    remote-endpoint = <&dc0_pixel_interleaver_ch0_dc0_pixel_link0>;
                };
            };

            /* to MIPI/LVDS combo subsystems */
            port@1 {
                #address-cells = <1>;
                #size-cells = <0>;
                reg = <1>;

                dc0_pixel_link0_mipi_lvds_0_pxl2dpi: endpoint@0 {
                    reg = <0>;
                    remote-endpoint = <&mipi_lvds_0_pxl2dpi_dc0_pixel_link0>;
                };

                dc0_pixel_link0_mipi_lvds_1_pxl2dpi: endpoint@1 {
                    reg = <1>;
                    remote-endpoint = <&mipi_lvds_1_pxl2dpi_dc0_pixel_link0>;
                };
            };
        };
    };
```

## Documentation/devicetree/bindings/display/imx/nxp,imx95-display-stream-csr.yaml
```yaml
# SPDX-License-Identifier: (GPL-2.0-only OR BSD-2-Clause)
%YAML 1.2
---
$id: http://devicetree.org/schemas/display/imx/nxp,imx95-display-stream-csr.yaml#
$schema: http://devicetree.org/meta-schemas/core.yaml#

title: NXP i.MX95 Display Stream Block Control

maintainers:
  - Marek Vasut <marek.vasut@mailbox.org>

properties:
  compatible:
    items:
      - enum:
          - nxp,imx95-display-stream-csr
          - nxp,imx95-master-stream-csr
          - nxp,imx95-mipi-tx-phy-csr
      - const: syscon

  reg:
    maxItems: 1

  clocks:
    maxItems: 1

required:
  - compatible
  - reg
  - clocks

additionalProperties: false

examples:
  - |
    syscon@4ad00000 {
      compatible = "nxp,imx95-display-stream-csr", "syscon";
      reg = <0x4ad00000 0x10000>;
      clocks = <&scmi_clk 62>;
    };
...
```

## Documentation/devicetree/bindings/net/wireless/nxp,iw61x.yaml
```yaml
# SPDX-License-Identifier: (GPL-2.0-only OR BSD-2-Clause)
%YAML 1.2
---
$id: http://devicetree.org/schemas/net/wireless/nxp,iw61x.yaml#
$schema: http://devicetree.org/meta-schemas/core.yaml#

title: NXP IW61x SDIO devices

maintainers:
  - Jeff Chen <jeff.chen_1@nxp.com>

description:
  This node provides properties for describing the NXP SDIO wireless device.
  The node is expected to be specified as a child node to the SDIO controller that
  connects the device to the system.

properties:
  compatible:
    enum:
      - nxp,iw612

  reg:
    maxItems: 1

  interrupts:
    maxItems: 1

  wakeup-source: true

  nxp,caldata-txpwrlimit-2g:
    $ref: /schemas/types.yaml#/definitions/uint8-array
    description: Calibration data for the 2GHz band.
    maxItems: 566

  nxp,caldata-txpwrlimit-5g-sub0:
    $ref: /schemas/types.yaml#/definitions/uint8-array
    description: Calibration data for sub-band 0 in the 5GHz band.
    maxItems: 502

  nxp,caldata-txpwrlimit-5g-sub1:
    $ref: /schemas/types.yaml#/definitions/uint8-array
    description: Calibration data for sub-band 1 in the 5GHz band.
    maxItems: 688

  nxp,caldata-txpwrlimit-5g-sub2:
    $ref: /schemas/types.yaml#/definitions/uint8-array
    description: Calibration data for sub-band 2 in the 5GHz band.
    maxItems: 750

  nxp,caldata-txpwrlimit-5g-sub3:
    $ref: /schemas/types.yaml#/definitions/uint8-array
    description: Calibration data for sub-band 3 in the 5GHz band.
    maxItems: 502

  nxp,wakeup-pin:
    $ref: /schemas/types.yaml#/definitions/uint32
    description:
      Provides the pin number for the wakeup pin from the device's point of
      view. The wakeup pin is used for the device to wake the host system
      from sleep. This property is only necessary if the wakeup pin is
      wired in a non-standard way, such that the default pin assignments
      are invalid.

required:
  - compatible
  - reg

additionalProperties: false

examples:
  - |
    #include <dt-bindings/interrupt-controller/irq.h>

    mmc {
        #address-cells = <1>;
        #size-cells = <0>;

        wifi@1 {
            compatible = "nxp,iw612";
            reg = <1>;
            interrupt-parent = <&pio>;
            interrupts = <38 IRQ_TYPE_LEVEL_LOW>;
            nxp,wakeup-pin = <3>;
        };
    };
```
